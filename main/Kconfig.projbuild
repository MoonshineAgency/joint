## main/Kconfig.projbuild
```kconfig
menu "*** iot-node configuration ***"

    menu "System configuration"

        config NODE_SYS_ID
            string "System ID template"
            default "NODE_%02X%02X%02X%02X%02X%02X"

    endmenu

    menu "Date/Time"

        config NODE_TZ
            string "Timezone"
            default "UTC"

        config SNTP_ENABLE
            bool "Enable SNTP date/time sync"
            default yes

        config SNTP_TIME_SERVER
            string "SNTP time server"
            default "pool.ntp.org"

    endmenu

    menu "Default WiFi configuration"
        
        menu "Access point mode"
        
            config NODE_WIFI_AP_SSID
                string "SSID"
                default "iot-node"
                
            config NODE_WIFI_AP_PASSWD
                string "Password"
                default ""
    
            config NODE_WIFI_AP_CHANNEL
                int "Channel"
                range 0 13
                default 6

        endmenu

        menu "Station mode"
        
            config NODE_WIFI_STA_SSID
                string "SSID"
                default "MyHomeWIFI"
                
            config NODE_WIFI_STA_PASSWD
                string "Password"
                default "MyPassword"
    
        endmenu

        config NODE_WIFI_DHCP
            bool "Enable DHCP"
            default y
            
        config NODE_WIFI_IP
            string "IP address"
            default "192.168.1.1"

        config NODE_WIFI_NETMASK
            string "Netmask"
            default "255.255.255.0"

        config NODE_WIFI_GATEWAY
            string "Gateway"
            default "192.168.1.1"
            
        config NODE_WIFI_DNS
            string "DNS server"
            default "192.168.1.1"

    endmenu
    
    menu "MQTT"

        config NODE_MQTT_URI
            string "MQTT Server URI"
            default "mqtt://192.168.88.1:1883"

        config NODE_MQTT_USERNAME
            string "Username"
            default "node"

        config NODE_MQTT_PASSWORD
            string "Password"
            default "node"

    endmenu

    menu "Driver settings"

        config DEFAULT_DRIVER_STACK_SIZE
            int "Default stack size for driver tasks"
            default 4096

        config I2C0_SDA_GPIO
            int "I2C0 SDA GPIO"
            default 16

        config I2C0_SCL_GPIO
            int "I2C0 SCL GPIO"
            default 17

        menu "AHT"

            config AHT_DRIVER_DEFAULT_STACK_SIZE
                int "AHT driver stack size"
                default 4096

            config AHT_DRIVER_MAX_DEVICES
                int "Maximal AHT devices count"
                default 8

        endmenu

        menu "DS18x20"

            config DS18X20_MAX_SENSORS
                int "Maximum number of DS18x20 sensors"
                default 64

        endmenu

        menu "GH IO"

            config GH_IO_DRIVER_INTR_GPIO
                int "GPIO for TCA9555 INTR pin"
                default 27

            config GH_IO_DRIVER_INPUTS_TOPIC
                string "Subtopic for publishing isolated inputs state"
                default "isolated_inputs"

            config GH_IO_DRIVER_SWITCHES_TOPIC
                string "Subtopic for publishing switches state"
                default "switches"

            config GH_IO_DRIVER_RELAYS_CMD_TOPIC
                string "Subtopic for controlling relays"
                default "relays/%d/command"

            config GH_IO_DRIVER_RELAYS_STATE_TOPIC
                string "Subtopic publishing relays state"
                default "relays/%d/state"

        endmenu

        menu "ADC"

            config ADC_DRIVER_TDS_CHANNEL
                int "ADC1 channel for TDS meter"
                default 3

            config ADC_DRIVER_AIN0_CHANNEL
                int "ADC1 channel AIN0"
                default 4

            config ADC_DRIVER_AIN1_CHANNEL
                int "ADC1 channel AIN1"
                default 5

            config ADC_DRIVER_AIN2_CHANNEL
                int "ADC1 channel AIN2"
                default 6

            config ADC_DRIVER_AIN3_CHANNEL
                int "ADC1 channel AIN3"
                default 7

        endmenu

    endmenu

endmenu
```
